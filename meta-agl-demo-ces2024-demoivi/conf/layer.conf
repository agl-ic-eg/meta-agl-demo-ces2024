## meta-agl-demo-ces2024-demoivi/conf/layer.conf
```bitbake
# We have a conf and classes directory, add to BBPATH
BBPATH =. "${LAYERDIR}:"

# We have recipes-* directories, add to BBFILES
BBFILES += "${LAYERDIR}/recipes-*/*/*.bb \
            ${LAYERDIR}/recipes-*/*/*.bbappend"

BBFILE_COLLECTIONS += "agldemo-ces2024-demoivi"
BBFILE_PATTERN_agldemo-ces2024-demoivi = "^${LAYERDIR}/"
BBFILE_PRIORITY_agldemo-ces2024-demoivi = "105"

BBFILES_DYNAMIC += " \
    rcar-gen3:${LAYERDIR}/dynamic-layers/meta-rcar-gen3/*/*/*.bb \
    rcar-gen3:${LAYERDIR}/dynamic-layers/meta-rcar-gen3/*/*/*.bbappend \
    raspberrypi:${LAYERDIR}/dynamic-layers/meta-raspberrypi/*/*/*.bb \
    raspberrypi:${LAYERDIR}/dynamic-layers/meta-raspberrypi/*/*/*.bbappend \
"

LAYERSERIES_COMPAT_agldemo-ces2024-demoivi = "kirkstone"
```

## meta-agl-demo-ces2024-ic/conf/layer.conf
```bitbake
# We have a conf and classes directory, add to BBPATH
BBPATH =. "${LAYERDIR}:"

# We have recipes-* directories, add to BBFILES
BBFILES += "${LAYERDIR}/recipes-*/*/*.bb \
            ${LAYERDIR}/recipes-*/*/*.bbappend"

BBFILE_COLLECTIONS += "agldemo-ces2024-ic"
BBFILE_PATTERN_agldemo-ces2024-ic = "^${LAYERDIR}/"
BBFILE_PRIORITY_agldemo-ces2024-ic = "105"

BBFILES_DYNAMIC += " \
    rcar-gen3:${LAYERDIR}/dynamic-layers/meta-rcar-gen3/*/*/*.bb \
    rcar-gen3:${LAYERDIR}/dynamic-layers/meta-rcar-gen3/*/*/*.bbappend \
    raspberrypi:${LAYERDIR}/dynamic-layers/meta-raspberrypi/*/*/*.bb \
    raspberrypi:${LAYERDIR}/dynamic-layers/meta-raspberrypi/*/*/*.bbappend \
"

# We do need psplash for guest images even we don't enable agldemo feature
BBFILES += "${METADIR}/meta-agl-demo/recipes-core/psplash/*.bb \
            ${METADIR}/meta-agl-demo/recipes-core/psplash/*.bbappend"

LAYERSERIES_COMPAT_agldemo-ces2024-ic = "kirkstone"

LAYERDEPENDS_agldemo-ces2024-ic = "aglcontainermc"
```
